#include <stdio.h>
#include <stdint.h>
#include "fonts.h"
#include "ssd1306_i2c.h"
#include "mytimer.h"

#define _SSD1306_I2C_ADDRESS 0x78

#define __cols 128
#define __rows 64


static const uint8_t data[] = {
  0x00, 0x00, 0x00, 0x00, 0x00, 0x00, 0x00, 0x00, 0x00, 0x00, 0x00, 0x00, 0x00, 0x00, 0x00, 0x00,
  0x00, 0x00, 0x00, 0x00, 0x00, 0x00, 0x00, 0x00, 0x00, 0x00, 0x00, 0x00, 0x00, 0x00, 0x00, 0x00,
  0x00, 0x00, 0x00, 0x00, 0x00, 0x00, 0x00, 0x00, 0x00, 0x00, 0x00, 0x80, 0x80, 0x80, 0x80, 0xc0,
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  0x00, 0x00, 0x00, 0x00, 0x00, 0x00, 0x00, 0x00, 0x00, 0x00, 0x00, 0x00, 0x00, 0x00, 0x00, 0x00
};

_ssd1306_i2c ssd1306;

uint8_t page = 0;
uint8_t col = 0;
char bit;

void callback_func(){
      ssd1306_i2c_work(&ssd1306, 1);
}

void callback_func_draw(){
      ssd1306_i2c_add_console_text(&ssd1306, "Mas texto");
      ssd1306_i2c_update(&ssd1306);
}

// Al display ssd1306 i2c - Por DMA - Data width: Byte
uint8_t ssd_send_data(uint16_t i2c_address, uint8_t *pData, uint16_t Size){
    ssd1306_i2c_send_complete(&ssd1306);
    if(pData[0] == _SSD1306_CONTROL_MULTIPLE_BYTE_DATA){
        for(uint16_t i = 1; i<Size; i++){
            for(uint8_t j = 0; j<8; j+=2){
                if((pData[i] & (1<<j)) == 0 && (pData[i] & (1<<(j+1))) == 0){
                    bit = ' ';
                }else if((pData[i] & (1<<j)) == 0 && (pData[i] & (1<<(j+1))) != 0){
                    bit = '.';
                }else if((pData[i] & (1<<j)) != 0 && (pData[i] & (1<<(j+1))) == 0){
                    bit = '\'';
                }else{
                    bit = ':';
                }
                printf("\033[%d;%dH%c", (page*4) + j/2 + 2 ,col + 2, bit);
            }
            col++;
            if(col == __cols){
                col = 0;
                page++;
                if(page == (__rows/8)){
                    page = 0;
                }
            }
        }
    }
    return 1;
}



int main(){
  printf("\033[2J");
  printf("\033[?25l");
  for(int i = 0; i<__cols+3; i++)
      for(int j = 0; j<(__rows/2)+3; j++)
          if((i==0 || i==__cols+2) && j !=0 && j!=(__rows/2)+2)
                printf("\033[%d;%dH|", j, i);
          else if(j==0)
                printf("\033[%d;%dH-", j, i);
          else if(j==(__rows/2)+2)
                printf("\033[%d;%dH_", j, i);

  ssd1306_i2c_init(&ssd1306, _SSD1306_I2C_ADDRESS, __cols, __rows);
  ssd1306_i2c_attach_send_data(&ssd1306, ssd_send_data);
  //ssd1306_i2c_set_mode(&ssd1306, _SSD1306_MODE_TEXT_AUTOSCROLL);
  ssd1306_i2c_set_mode(&ssd1306, _SSD1306_MODE_TEXT_CONSOLE);
  //ssd1306_i2c_set_mode(&ssd1306, _SSD1306_MODE_EXTERNAL_BITMAP);
  //ssd1306_i2c_set_mode(&ssd1306, _SSD1306_MODE_BITMAP);
  //ssd1306_i2c_set_exteral_bitmap(&ssd1306, data);
  // ssd1306_i2c_put_text(_ssd1306_i2c *ssd, const char *data, uint8_t at_line, uint8_t font, uint8_t fixed, uint8_t spacing)
  //uint8_t value[] = {128, 129, 130, 131, 132, 133, 134, 135, 136, 137, 138, 139, 0};
  //ssd1306_i2c_put_text(&ssd1306, value, 0, 5, 1, 1);
  //ssd1306_i2c_put_text(&ssd1306, "Texto con scroll y fuente grande\0", 1, 4, 0, 1);
  //ssd1306_i2c_put_text(&ssd1306, "Linea inferior, fuente pequena\0", 2, 1, 1, 1);
  //ssd1306_i2c_bitmap_draw_line(&ssd1306, 3, 5, 100, 40);
  //ssd1306_i2c_update(&ssd1306);
  mytimer_init(999);
  mytimer_attach(callback_func, 1);
  mytimer_attach(callback_func_draw, 1000);
  while(1);
}
